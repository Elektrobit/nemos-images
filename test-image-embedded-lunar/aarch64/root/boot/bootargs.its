## test-image-embedded-lunar/aarch64/root/boot/bootargs.its
```
/dts-v1/;
/ {
  description = "BaseOS Boot Image";
  #address-cells = <1>;
  images {
    kernel-1 {
      description = "Linux kernel image";
      data = /incbin/("vmlinuz");
      type = "kernel";
      arch = "arm64";
      os = "linux";
      compression = "gzip";
      load = <0x40400000>;
      entry = <0x40400000>;
      hash-1 { algo = "md5"; };
    };
    ramdisk-1 {
      description = "Initial ramdisk image";
      data = /incbin/("initrd");
      type = "ramdisk";
      arch = "arm64";
      os = "linux";
      compression = "none";
      load = <0x44000000>;
      hash-1 { algo = "md5"; };
    };
    fdt-1 {
      description = "QEMU device tree";
      data = /incbin/("qemu.dtb");
      type = "flat_dt";
      arch = "arm64";
      os = "linux";
      compression = "none";
      load = <0x43000000>;
      hash-1 { algo = "md5"; };
    };
  };
  configurations {
    default = "config-1";
    config-1 {
      description = "Default boot config";
      kernel = "kernel-1";
      ramdisk = "ramdisk-1";
      fdt = "fdt-1";
    };
  };
};
```
